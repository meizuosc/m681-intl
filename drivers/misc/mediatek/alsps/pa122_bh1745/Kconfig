## drivers/misc/mediatek/alsps/pa122_bh1745/Kconfig
```kconfig
config MTK_PA122_BH1745
	bool "ap122 and bh1745 for MediaTek package"
	default n
```

## drivers/misc/mediatek/fingerprint/Kconfig
```kconfig
source "drivers/misc/mediatek/fingerprint/gfx1xm/Kconfig"
source "drivers/misc/mediatek/fingerprint/gf516m/Kconfig"
```

## drivers/misc/mediatek/fingerprint/gf516m/Kconfig
```kconfig
config FINGERPRINT_GOODIX_GF516M
  bool FINGERPRINT_GOODIX_GF516M
  default n
  help
    Goodix Fingerprint chip GF316M/GF516M/GF616M/GF318M
```

## drivers/misc/mediatek/flashlight/Kconfig
```kconfig
config MTK_FLASHLIGHT
  bool CONFIG_MTK_FLASHLIGHT
  default n
  help
    CONFIG_MTK_FLASHLIGHT

config HQ_FLASHLIGHT_IC_LM3642
  bool CONFIG_HQ_FLASHLIGHT_IC_LM3642
  default n
  help
  CONFIG_HQ_FLASHLIGHT_IC_LM3642
```
